## examples/link/sdkconfig.defaults
```kconfig
# T-Beam Supreme has 8MB flash (not 16MB like default devkitc-1)
CONFIG_ESPTOOLPY_FLASHSIZE_8MB=y
CONFIG_PARTITION_TABLE_CUSTOM=y
CONFIG_PARTITION_TABLE_CUSTOM_FILENAME="no_ota.csv"
```

## examples/lxmf_tdeck/sdkconfig.defaults
```kconfig
# Required for Arduino framework
CONFIG_FREERTOS_HZ=1000

# Flash configuration for 8MB
CONFIG_ESPTOOLPY_FLASHSIZE_8MB=y
CONFIG_PARTITION_TABLE_CUSTOM=y
CONFIG_PARTITION_TABLE_CUSTOM_FILENAME="partitions.csv"

# Enable Bluetooth
CONFIG_BT_ENABLED=y

# Use NimBLE instead of Bluedroid
CONFIG_BT_NIMBLE_ENABLED=y
CONFIG_BT_BLUEDROID_ENABLED=n

# NimBLE role configuration - enable both central and peripheral
CONFIG_BT_NIMBLE_ROLE_CENTRAL=y
CONFIG_BT_NIMBLE_ROLE_PERIPHERAL=y
CONFIG_BT_NIMBLE_ROLE_BROADCASTER=y
CONFIG_BT_NIMBLE_ROLE_OBSERVER=y

# NimBLE connection settings
CONFIG_BT_NIMBLE_MAX_CONNECTIONS=7
CONFIG_BT_NIMBLE_MAX_BONDS=10

# NimBLE GATT settings
CONFIG_BT_NIMBLE_ATT_PREFERRED_MTU=517
CONFIG_BT_NIMBLE_GAP_DEVICE_NAME_MAX_LEN=31

# Extended advertising for better compatibility
CONFIG_BT_NIMBLE_EXT_ADV=y

# Increase task stack size for stability
CONFIG_BT_NIMBLE_TASK_STACK_SIZE=8192

# Enable debug logging for troubleshooting
CONFIG_BT_NIMBLE_DEBUG=y
CONFIG_BT_NIMBLE_LOG_LEVEL=1

# Coexistence with WiFi
CONFIG_ESP32_WIFI_SW_COEXIST_ENABLE=y

# Enable C++ exceptions (required for microReticulum)
CONFIG_COMPILER_CXX_EXCEPTIONS=y
CONFIG_COMPILER_CXX_EXCEPTIONS_EMG_POOL_SIZE=0

# Enable PSRAM (8MB external RAM) for zero heap fragmentation
CONFIG_ESP32S3_SPIRAM_SUPPORT=y
CONFIG_SPIRAM=y
CONFIG_SPIRAM_MODE_OCT=y
CONFIG_SPIRAM_SPEED_80M=y

# Configure malloc to use PSRAM
CONFIG_SPIRAM_USE_MALLOC=y
# Allocations smaller than this go to internal RAM (bytes)
CONFIG_SPIRAM_MALLOC_ALWAYSINTERNAL=4096
# Reserve this much internal RAM for DMA/ISR (bytes)
CONFIG_SPIRAM_MALLOC_RESERVE_INTERNAL=32768
```
